## config/boards/shields/mzslim/Kconfig.defconfig
```kconfig
if SHIELD_MZSLIM_LEFT

config ZMK_KEYBOARD_NAME
    default "mzslim"
config ZMK_USB
    default y
config ZMK_SPLIT_ROLE_CENTRAL
    default y

endif

if SHIELD_MZSLIM_LEFT || SHIELD_MZSLIM_RIGHT

config ZMK_SPLIT
    default y

endif
```

## config/boards/shields/mzslim/Kconfig.shield
```kconfig
config SHIELD_MZSLIM_LEFT
    def_bool $(shields_list_contains,mzslim_left)

config SHIELD_MZSLIM_RIGHT
    def_bool $(shields_list_contains,mzslim_right)
```
